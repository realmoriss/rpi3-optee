## Config.in
```kconfig
source "$BR2_EXTERNAL_RPI3_OPTEE_PATH/package/optee-client/Config.in"
source "$BR2_EXTERNAL_RPI3_OPTEE_PATH/package/optee-test/Config.in"
source "$BR2_EXTERNAL_RPI3_OPTEE_PATH/package/optee-examples/Config.in"
source "$BR2_EXTERNAL_RPI3_OPTEE_PATH/package/optee-os/Config.in"
source "$BR2_EXTERNAL_RPI3_OPTEE_PATH/package/arm-tf/Config.in"
source "$BR2_EXTERNAL_RPI3_OPTEE_PATH/package/uboot-rpi3/Config.in"
source "$BR2_EXTERNAL_RPI3_OPTEE_PATH/package/rpi3-firmware/Config.in"
```

## board/rpi3/configs/uboot_defconfig
```kconfig
CONFIG_FIT=y
CONFIG_OF_CONTROL=y
CONFIG_FIT_SIGNATURE=y
CONFIG_FIT_RSA=y
CONFIG_FIT_VERBOSE=y
```

## configs/rpi3_defconfig
```kconfig
BR2_aarch64=y
BR2_cortex_a53=y
BR2_ARM_FPU_VFPV4=y
BR2_JLEVEL=0
BR2_TOOLCHAIN_EXTERNAL=y
BR2_TOOLCHAIN_EXTERNAL_LINARO_AARCH64=y
BR2_SYSTEM_DHCP="eth0"
BR2_ROOTFS_POST_BUILD_SCRIPT="$(BR2_EXTERNAL_RPI3_OPTEE_PATH)/board/rpi3/post-build.sh"
BR2_ROOTFS_POST_IMAGE_SCRIPT="$(BR2_EXTERNAL_RPI3_OPTEE_PATH)/board/rpi3/post-image.sh"
BR2_ROOTFS_OVERLAY="$(BR2_EXTERNAL_RPI3_OPTEE_PATH)/board/rpi3/rootfs-overlay"
BR2_TARGET_GENERIC_ROOT_PASSWD="root"
BR2_ROOTFS_DEVICE_TABLE="$(BR2_EXTERNAL_RPI3_OPTEE_PATH)/board/rpi3/device_table.txt"

BR2_LINUX_KERNEL=y
BR2_LINUX_KERNEL_CUSTOM_GIT=y
BR2_LINUX_KERNEL_CUSTOM_REPO_URL="https://github.com/linaro-swg/linux.git"
BR2_LINUX_KERNEL_CUSTOM_REPO_VERSION="rpi3-optee-4.6"
BR2_LINUX_KERNEL_DEFCONFIG="bcmrpi3"
BR2_LINUX_KERNEL_CONFIG_FRAGMENT_FILES="$(BR2_EXTERNAL_RPI3_OPTEE_PATH)/board/rpi3/configs/linux_defconfig"
BR2_LINUX_KERNEL_DTS_SUPPORT=y
BR2_LINUX_KERNEL_INTREE_DTS_NAME="broadcom/bcm2710-rpi-3-b"
# BR2_PACKAGE_RPI_FIRMWARE is not set
# BR2_PACKAGE_RPI_FIRMWARE_INSTALL_DTB_OVERLAYS is not set
BR2_PACKAGE_RPI_WIFI_FIRMWARE=y

BR2_PACKAGE_HOST_DOSFSTOOLS=y
BR2_PACKAGE_HOST_E2FSPROGS=y
BR2_PACKAGE_HOST_GENIMAGE=y
BR2_PACKAGE_HOST_MTOOLS=y

BR2_PACKAGE_OPENSSH=y
BR2_PACKAGE_NANO=y
BR2_PACKAGE_MC=y
BR2_PACKAGE_NTP=y
BR2_PACKAGE_NTP_NTPDATE=y

BR2_PACKAGE_OVERRIDE_FILE="$(BR2_EXTERNAL_RPI3_OPTEE_PATH)/local.mk"

BR2_PACKAGE_OPTEE_OS=y
BR2_PACKAGE_OPTEE_OS_64BIT=y
BR2_PACKAGE_OPTEE_OS_PLATFORM="rpi3"

BR2_PACKAGE_UBOOT_RPI3=y
BR2_PACKAGE_UBOOT_RPI3_ENVIMAGE_SOURCE="$(BR2_EXTERNAL_RPI3_OPTEE_PATH)/board/rpi3/uboot.env.txt"
BR2_PACKAGE_UBOOT_RPI3_ENVIMAGE_SIZE="0x4000"

BR2_PACKAGE_RPI3_FIRMWARE=y

BR2_GENERATE_LOCALE="en_US.UTF-8"
BR2_TARGET_TZ_INFO=y
BR2_TARGET_LOCALTIME="Europe/Budapest"

BR2_TARGET_GENERIC_GETTY_PORT="ttyS0"
BR2_TARGET_GENERIC_GETTY_TERM="vt100"

BR2_PACKAGE_NCURSES_WCHAR=y
```

## package/arm-tf/Config.in
```kconfig
config BR2_PACKAGE_ARM_TF
	bool "arm-tf"
	select BR2_PACKAGE_OPTEE_OS
	help
	  https://github.com/linaro-swg/arm-trusted-firmware

if BR2_PACKAGE_ARM_TF
config BR2_PACKAGE_ARM_TF_SITE
	string "ARM Trusted Firmware path"
	default "git://github.com/linaro-swg/arm-trusted-firmware.git"
	help
	  The path to the source directory of ARM Trusted Firmware
endif
```

## package/optee-client/Config.in
```kconfig
config BR2_PACKAGE_OPTEE_CLIENT
	bool "optee-client"
	select BR2_PACKAGE_OPTEE_OS
	help
	  https://github.com/OP-TEE/optee_client
```

## package/optee-examples/Config.in
```kconfig
config BR2_PACKAGE_OPTEE_EXAMPLES
	bool "optee-examples"
	select BR2_PACKAGE_HOST_PYTHON_PYCRYPTO
	select BR2_PACKAGE_OPTEE_CLIENT
	help
	  https://github.com/linaro-swg/optee_examples
```

## package/optee-os/Config.in
```kconfig
config BR2_PACKAGE_OPTEE_OS
	bool "optee-os"
	selects BR2_PACKAGE_PYTHON_PYCRYPTO
	help
	  https://github.com/OP-TEE/optee_os

if BR2_PACKAGE_OPTEE_OS
config BR2_PACKAGE_OPTEE_OS_SITE
	string "OP-TEE OS path"
	default "git://github.com/OP-TEE/optee_os.git"
	help
	  The path to the source directory of OP-TEE os
	  
config BR2_PACKAGE_OPTEE_OS_PLATFORM
	string "OP-TEE OS platform"
	help
	  The name of the platform OP-TEE is compiled for
	  
config BR2_PACKAGE_OPTEE_OS_64BIT
	bool "OP-TEE 64-bit support"
	help
	  Compile OP-TEE with 64-bit TAs
endif
```

## package/optee-test/Config.in
```kconfig
config BR2_PACKAGE_OPTEE_TEST
	bool "optee-test"
	select BR2_PACKAGE_OPTEE_CLIENT
	select BR2_PACKAGE_OPENSSL
	select BR2_PACKAGE_HOST_PYTHON_PYCRYPTO
	help
	  http://github.org/OP-TEE/optee_test
```

## package/rpi3-firmware/Config.in
```kconfig
config BR2_PACKAGE_RPI3_FIRMWARE
	bool "rpi3-firmware"
	help
	  https://github.com/raspberrypi/firmware
```

## package/rpi3-head-bin/Config.in
```kconfig
config BR2_PACKAGE_RPI3_HEAD_BIN
	bool "rpi3-head-bin"
	default "y"
	select BR2_PACKAGE_UBOOT
	help
```

## package/uboot-rpi3/Config.in
```kconfig
config BR2_PACKAGE_UBOOT_RPI3
	bool "uboot-rpi3"
	help
	  https://github.com/linaro-swg/u-boot

if BR2_PACKAGE_UBOOT_RPI3
config BR2_PACKAGE_UBOOT_RPI3_ENVIMAGE_SOURCE
	string "Environment image source path"
	help
	  The path of the environment image source
	  
config BR2_PACKAGE_UBOOT_RPI3_ENVIMAGE_SIZE
	string "Environment image size"
	help
	  The size of the environment image
	  
config BR2_PACKAGE_UBOOT_RPI3_CONFIG_FRAGMENT_FILES
	string "Defconfig fragment files"
	help
	  Files which will be appended to defconfig
endif
```

## package/uboot-rpi3/sources/rpi3_fit.its
```
/dts-v1/;

/ {
	description = "RPi3 FIT Image";
	#address-cells = <2>;

	images {
		kernel-1 {
			description = "default kernel";
			data = /incbin/("Image");
			type = "kernel";
			arch = "arm64";
			os = "linux";
			compression = "none";
			load =  <0x00080000>;
			entry = <0x00080000>;
			hash@1 {
				algo = "sha1";
			};
		};
		tee-1 {
			description = "atf";
			data = /incbin/("optee.bin");
			type = "standalone";
			arch = "arm64";
			compression = "none";
			load =  <0x08400000>;
			entry = <0x08400000>;
			hash@1 {
				algo = "sha1";
			};
		};
		fdt-1 {
			description = "device tree";
			data = /incbin/("bcm2710-rpi-3-b.dtb");
			type = "flat_dt";
			arch = "arm64";
			compression = "none";
			hash@1 {
				algo = "sha1";
			};
		};
	};
	configurations {
		default = "config-1";

		config-1 {
			description = "default configuration";
			kernel = "kernel-1";
			loadables = "tee-1";
			fdt = "fdt-1";
			signature-1 {
				algo = "sha1,rsa2048";
				key-name-hint = "dev";
				sign-images = "fdt", "kernel", "loadables";
			};
		};
	};
};
```
